## layers/meta-em-odp/conf/layer.conf
```bitbake
# We have a conf and classes directory, add to BBPATH
BBPATH .= ":${LAYERDIR}"

# We have recipes-* directories, add to BBFILES
BBFILES += "${LAYERDIR}/recipes-*/*/*.bb \
            ${LAYERDIR}/recipes-*/*/*.bbappend"

BBFILE_COLLECTIONS += "meta-em-odp"
BBFILE_PATTERN_meta-em-odp = "^${LAYERDIR}/"
BBFILE_PRIORITY_meta-em-odp = "6"

LAYERDEPENDS_meta-em-odp = "core"
LAYERSERIES_COMPAT_meta-em-odp = "dunfell"
```

## layers/meta-menabrea-app/conf/layer.conf
```bitbake
# We have a conf and classes directory, add to BBPATH
BBPATH .= ":${LAYERDIR}"

# We have recipes-* directories, add to BBFILES
BBFILES += "${LAYERDIR}/recipes-*/*/*.bb \
            ${LAYERDIR}/recipes-*/*/*.bbappend"

BBFILE_COLLECTIONS += "meta-menabrea-app"
BBFILE_PATTERN_meta-menabrea-app = "^${LAYERDIR}/"
BBFILE_PRIORITY_meta-menabrea-app = "6"

LAYERDEPENDS_meta-menabrea-app = "core"
LAYERSERIES_COMPAT_meta-menabrea-app = "kirkstone"
```

## layers/meta-menabrea-drivers/conf/layer.conf
```bitbake
# We have a conf and classes directory, add to BBPATH
BBPATH .= ":${LAYERDIR}"

# We have recipes-* directories, add to BBFILES
BBFILES += "${LAYERDIR}/recipes-*/*/*.bb \
            ${LAYERDIR}/recipes-*/*/*.bbappend"

BBFILE_COLLECTIONS += "meta-menabrea-drivers"
BBFILE_PATTERN_meta-menabrea-drivers = "^${LAYERDIR}/"
BBFILE_PRIORITY_meta-menabrea-drivers = "6"

LAYERDEPENDS_meta-menabrea-drivers = "core"
LAYERSERIES_COMPAT_meta-menabrea-drivers = "scarthgap"
```

## layers/meta-menabrea-kernel/conf/layer.conf
```bitbake
# We have a conf and classes directory, add to BBPATH
BBPATH .= ":${LAYERDIR}"

# We have recipes-* directories, add to BBFILES
BBFILES += "${LAYERDIR}/recipes-*/*/*.bb \
            ${LAYERDIR}/recipes-*/*/*.bbappend"

BBFILE_COLLECTIONS += "meta-menabrea-kernel"
BBFILE_PATTERN_meta-menabrea-kernel = "^${LAYERDIR}/"
BBFILE_PRIORITY_meta-menabrea-kernel = "6"

LAYERDEPENDS_meta-menabrea-kernel = "core"
LAYERSERIES_COMPAT_meta-menabrea-kernel = "kirkstone"
```

## layers/meta-menabrea-platform-test/conf/layer.conf
```bitbake
# We have a conf and classes directory, add to BBPATH
BBPATH .= ":${LAYERDIR}"

# We have recipes-* directories, add to BBFILES
BBFILES += "${LAYERDIR}/recipes-*/*/*.bb \
            ${LAYERDIR}/recipes-*/*/*.bbappend"

BBFILE_COLLECTIONS += "meta-menabrea-platform-test"
BBFILE_PATTERN_meta-menabrea-platform-test = "^${LAYERDIR}/"
BBFILE_PRIORITY_meta-menabrea-platform-test = "6"

LAYERDEPENDS_meta-menabrea-platform-test = "core"
LAYERSERIES_COMPAT_meta-menabrea-platform-test = "mickledore"
```

## layers/meta-menabrea-platform/conf/layer.conf
```bitbake
# We have a conf and classes directory, add to BBPATH
BBPATH .= ":${LAYERDIR}"

# We have recipes-* directories, add to BBFILES
BBFILES += "${LAYERDIR}/recipes-*/*/*.bb \
            ${LAYERDIR}/recipes-*/*/*.bbappend"

BBFILE_COLLECTIONS += "meta-menabrea-platform"
BBFILE_PATTERN_meta-menabrea-platform = "^${LAYERDIR}/"
BBFILE_PRIORITY_meta-menabrea-platform = "6"

LAYERDEPENDS_meta-menabrea-platform = "core"
LAYERSERIES_COMPAT_meta-menabrea-platform = "kirkstone"
```

## layers/meta-menabrea-test-harness/conf/layer.conf
```bitbake
# We have a conf and classes directory, add to BBPATH
BBPATH .= ":${LAYERDIR}"

# We have recipes-* directories, add to BBFILES
BBFILES += "${LAYERDIR}/recipes-*/*/*.bb \
            ${LAYERDIR}/recipes-*/*/*.bbappend"

BBFILE_COLLECTIONS += "meta-menabrea-test-harness"
BBFILE_PATTERN_meta-menabrea-test-harness = "^${LAYERDIR}/"
BBFILE_PRIORITY_meta-menabrea-test-harness = "6"

LAYERDEPENDS_meta-menabrea-test-harness = "core"
LAYERSERIES_COMPAT_meta-menabrea-test-harness = "scarthgap"
```

## layers/meta-menabrea/conf/distro/menabrea-common.inc
```bitbake
# Base this distribution on poky
require conf/distro/poky.conf

# Remove unused distro features
DISTRO_FEATURES:remove = \
    "acl alsa bluetooth debuginfod usbgadget usbhost wifi nfs zeroconf 3g nfc x11 opengl wayland vulkan pulseaudio gobject-introspection-data"

# Use systemd as init manager
INIT_MANAGER = "systemd"

# Add sources and config directories
FILESPATH:append = ":${TOPDIR}/../src"
FILESPATH:append = ":${TOPDIR}/../config"

# Let systemd start the platform at boot by default, unless running a development build
MENABREA_AUTOSTART              = "1"
MENABREA_AUTOSTART:menabrea-dev = "0"

# Enable UART on the Raspberry Pi 4 in the development image
ENABLE_UART:menabrea-dev := "1"
```

## layers/meta-menabrea/conf/distro/menabrea-node1.conf
```bitbake
require menabrea-common.inc

DISTRO = "menabrea-node1"
DISTRO_NAME = "menabrea-node1 (Menabrea distribution for node 1)"
DISTRO_VERSION = "1.0.0"
DISTRO_CODENAME = "menabrea-node1"
```

## layers/meta-menabrea/conf/distro/menabrea-node2.conf
```bitbake
require menabrea-common.inc

DISTRO = "menabrea-node2"
DISTRO_NAME = "menabrea-node2 (Menabrea distribution for node 2)"
DISTRO_VERSION = "1.0.0"
DISTRO_CODENAME = "menabrea-node2"
```

## layers/meta-menabrea/conf/distro/menabrea-node3.conf
```bitbake
require menabrea-common.inc

DISTRO = "menabrea-node3"
DISTRO_NAME = "menabrea-node3 (Menabrea distribution for node 3)"
DISTRO_VERSION = "1.0.0"
DISTRO_CODENAME = "menabrea-node3"
```

## layers/meta-menabrea/conf/distro/menabrea-qemu.conf
```bitbake
# Base this distribution on poky
require conf/distro/poky.conf

DISTRO = "menabrea-qemu"
DISTRO_NAME = "menabrea-qemu (Menabrea distribution for QEMU)"
DISTRO_VERSION = "1.0.0"
DISTRO_CODENAME = "menabrea-qemu"

require menabrea-common.inc

# Emulate a quad-core Raspberry Pi 4 with 2 GB of memory
QB_SMP = "-smp 4"
QB_MEM = "-m 2048"
# Isolate cores from the scheduler
QB_KERNEL_CMDLINE_APPEND = "isolcpus=1,2,3"
```
